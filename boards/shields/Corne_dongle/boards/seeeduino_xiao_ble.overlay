/*
 * Board-specific overlay for Seeeduino XIAO BLE (Prospector Dongle).
 * Cleans up the dtsi's RGB/WS2812 SPI3 configuration so the
 * prospector_adapter shield can use SPI3 cleanly for the ST7789V display.
 */

/ {
    chosen {
        /delete-property/ zmk,underglow;
        /delete-property/ zephyr,display;
    };
};

&spi3 {
    /delete-node/ ws2812@0;
};
